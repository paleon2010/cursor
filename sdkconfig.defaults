## sdkconfig.defaults
```kconfig
# Configuración por defecto para ESP32-WROOM-32

# Configuración de WiFi
CONFIG_ESP32_WIFI_STATIC_RX_BUFFER_NUM=10
CONFIG_ESP32_WIFI_DYNAMIC_RX_BUFFER_NUM=32
CONFIG_ESP32_WIFI_STATIC_TX_BUFFER_NUM=0
CONFIG_ESP32_WIFI_DYNAMIC_TX_BUFFER_NUM=32

# Configuración de FreeRTOS
CONFIG_FREERTOS_HZ=1000
CONFIG_FREERTOS_ASSERT_ON_UNTESTED_FUNCTION=y

# Configuración de SPI
CONFIG_SPI_MASTER_IN_IRAM=y

# Configuración de I2C
CONFIG_I2C_ENABLE_DEBUG_LOG=n

# Configuración de HTTP Server
CONFIG_HTTPD_MAX_REQ_HDR_LEN=512
CONFIG_HTTPD_MAX_URI_LEN=512

# Configuración de partición (usar tabla por defecto)
CONFIG_PARTITION_TABLE_SINGLE_APP=y

# Configuración de logging
CONFIG_LOG_DEFAULT_LEVEL_INFO=y
CONFIG_LOG_MAXIMUM_LEVEL_VERBOSE=y
```
